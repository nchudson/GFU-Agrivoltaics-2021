//------------------------------------------------------------------------------
// GFU Agrivoltaics Common Functions
// Nathaniel Hudson
// nhudson18@georgefox.edu
// Summer 2021
//------------------------------------------------------------------------------

//------------------------------------------------------------------------------
//             __             __   ___  __
//     | |\ | /  ` |    |  | |  \ |__  /__`
//     | | \| \__, |___ \__/ |__/ |___ .__/
//
//------------------------------------------------------------------------------

#include "functions.h"

//------------------------------------------------------------------------------
//      __   ___  ___         ___  __
//     |  \ |__  |__  | |\ | |__  /__`
//     |__/ |___ |    | | \| |___ .__/
//
//------------------------------------------------------------------------------

//------------------------------------------------------------------------------
//     ___      __   ___  __   ___  ___  __
//      |  \ / |__) |__  |  \ |__  |__  /__`
//      |   |  |    |___ |__/ |___ |    .__/
//
//------------------------------------------------------------------------------

//------------------------------------------------------------------------------
//                __          __        ___  __
//     \  /  /\  |__) |  /\  |__) |    |__  /__`
//      \/  /~~\ |  \ | /~~\ |__) |___ |___ .__/
//
//------------------------------------------------------------------------------

//------------------------------------------------------------------------------
//      __   __   __  ___  __  ___      __   ___  __
//     |__) |__) /  \  |  /  \  |  \ / |__) |__  /__`
//     |    |  \ \__/  |  \__/  |   |  |    |___ .__/
//
//------------------------------------------------------------------------------

//------------------------------------------------------------------------------
//      __        __          __
//     |__) |  | |__) |    | /  `
//     |    \__/ |__) |___ | \__,
//
//------------------------------------------------------------------------------

//==============================================================================
// Manage log_file Creation
//==============================================================================
bool create_log_file(File* log_file, time_t t, char* header) {
  // Local variables.
  bool exists = false;
  bool created = false;

  // Close the current file and create a new one.
  log_file.close();

  // Get the current time (MM-DD_HH) and use it as the file name,
  // first checking whether file already exists.
  sprintf(file_name, "%02d-%02d_%02d.log", month(t), day(t), hour(t));
  exists = SD.exists(file_name);
  log_file = SD.open(file_name, FILE_WRITE);

  // Print filename and failure state.
  if (!log_file)
  {
    Serial.print("File failed to open with name '");
    Serial.print(file_name);
    Serial.println("'");
  }
  else
  {
    Serial.print("Opened log_file file with name '");
    Serial.print(file_name);
    Serial.println("'");
    created = true;
  }

  // If file did not already exist, initialize first line
  // with ThingSpeak CSV header.
  if(!exists) {
    log_file.println(header);
  }
  return created;
}

//==============================================================================
// Reset System
//==============================================================================
void system_reset() {
  // Use watchdog timer and spin-wait to trigger reset.
  wdt_disable();
  Serial.println("//////////////////");
  Serial.println("// SYSTEM RESET //");
  Serial.println("//////////////////");
  delay(100);
  wdt_enable(WDTO_15MS);
  while(1) ;
}